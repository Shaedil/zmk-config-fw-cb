## Kconfig
```kconfig
# Copyright (c) 2026 Shaedil
# SPDX-License-Identifier: MIT

if BOARD_FRAMEWORK_WIRELESS_TP_KB_NRF54LM20A_CPUAPP_ZMK

config FRAMEWORK_CB_WATCHDOG
	bool "Reset the board if the firmware hangs"
	default y
	select WATCHDOG
	help
	  The board has no reset button.  WDT31 resets it into MCUboot if the
	  system workqueue stops running.

config FRAMEWORK_CB_WATCHDOG_TIMEOUT_MS
	int "Watchdog timeout in milliseconds"
	default 8000
	depends on FRAMEWORK_CB_WATCHDOG

config FRAMEWORK_CB_MODE_SWITCH
	bool "Use S1 to choose between wired and Bluetooth"
	default y
	depends on ZMK_BLE && ZMK_USB
	select INPUT
	help
	  ON sends over Bluetooth, falling back to USB when no host is
	  connected.  OFF turns Bluetooth off and sends over USB.  Reads S1
	  through Framework's protocol_switch key.  Needs patches/zmk/.

config FRAMEWORK_CB_FUEL_GAUGE
	bool "Battery level from nRF Fuel Gauge"
	default y
	depends on DT_HAS_SHAEDIL_NPM1300_FUEL_GAUGE_ENABLED
	select SENSOR
	select REQUIRES_FULL_LIBC
	help
	  Tracks the cell with Nordic's nRF Fuel Gauge library, fed by the
	  nPM1300's voltage, current, temperature and charge state.

config FRAMEWORK_CB_STATUS_LED
	bool "Light the blue LED while connected to a host"
	default y
	help
	  The RGB LED is driven off at boot either way.

endif # BOARD_FRAMEWORK_WIRELESS_TP_KB_NRF54LM20A_CPUAPP_ZMK
```

## boards/framework/framework_wireless_tp_kb/Kconfig.framework_wireless_tp_kb
```kconfig
# Copyright (c) 2026 Shaedil
# SPDX-License-Identifier: MIT

config BOARD_FRAMEWORK_WIRELESS_TP_KB
	select SOC_NRF54LM20A_CPUAPP if BOARD_FRAMEWORK_WIRELESS_TP_KB_NRF54LM20A_CPUAPP_ZMK
	select ZMK_BOARD_COMPAT if BOARD_FRAMEWORK_WIRELESS_TP_KB_NRF54LM20A_CPUAPP_ZMK
```

## boards/framework/framework_wireless_tp_kb/framework_wireless_tp_kb_nrf54lm20a_cpuapp_zmk_defconfig
```kconfig
# Copyright (c) 2026 Shaedil
# SPDX-License-Identifier: MIT

# SoC setup, as in Framework's board defconfig
CONFIG_GPIO=y
CONFIG_I2C=y
CONFIG_ARM_MPU=y
CONFIG_NULL_POINTER_EXCEPTION_DETECTION_NONE=y
CONFIG_CACHE_MANAGEMENT=y
CONFIG_EXTERNAL_CACHE=y
CONFIG_NRF_GRTC_START_SYSCOUNTER=y

# Settings in the storage partition
CONFIG_FLASH=y
CONFIG_FLASH_MAP=y
CONFIG_ZMS=y
CONFIG_SETTINGS_ZMS=y
CONFIG_MPU_ALLOW_FLASH_WRITE=y

# Matches Framework's MCUboot (daisy branch)
CONFIG_MCUBOOT_BOOTLOADER_MODE_OVERWRITE_ONLY=y

CONFIG_ZMK_BLE=y

CONFIG_ZMK_USB=y
CONFIG_ZMK_USB_DEVICE_STACK_NEXT=y

CONFIG_ZMK_BATTERY_REPORTING=y
CONFIG_ZMK_BATTERY_REPORTING_FETCH_MODE_STATE_OF_CHARGE=y
```

## boards/shields/framework_cb_matrix/Kconfig.defconfig
```kconfig
# Copyright (c) 2026 Shaedil
# SPDX-License-Identifier: MIT

if SHIELD_FRAMEWORK_CB_MATRIX

config ZMK_KEYBOARD_NAME
    default "Framework CB"

endif # SHIELD_FRAMEWORK_CB_MATRIX
```

## boards/shields/framework_cb_matrix/Kconfig.shield
```kconfig
# Copyright (c) 2026 Shaedil
# SPDX-License-Identifier: MIT

config SHIELD_FRAMEWORK_CB_MATRIX
    def_bool $(shields_list_contains,framework_cb_matrix)
```

## dts/bindings/shaedil,npm1300-fuel-gauge.yaml
```yaml
description: State of charge from nRF Fuel Gauge and an nPM1300 charger

compatible: "shaedil,npm1300-fuel-gauge"

include: base.yaml

properties:
  charger:
    type: phandle
    required: true
```
